## CMakeLists.txt
```
cmake_minimum_required(VERSION 3.20.0)

# Always generate compilation database.
set(CMAKE_EXPORT_COMPILE_COMMANDS ON CACHE INTERNAL "")

# Set project name, used for firmware output filename.
set(PROJECT_NAME test_zyphal)

find_package(Zephyr REQUIRED HINTS "${CMAKE_CURRENT_SOURCE_DIR}/../../../zephyr")
project(app LANGUAGES C)

target_sources(app PRIVATE
    "src/can_fff.c"
    "src/test_transmit.c"
)

target_include_directories(app PRIVATE
    "${CMAKE_CURRENT_SOURCE_DIR}/../inc"
    "${CMAKE_CURRENT_SOURCE_DIR}/../src"
)
```

## prj.conf
```kconfig
CONFIG_CAN=y
CONFIG_CAN_FD_MODE=y

CONFIG_ZYPHAL=y
CONFIG_ZYPHAL_CAN_FD=y

CONFIG_ZTEST=y

CONFIG_ASAN=y
CONFIG_UBSAN=y
```

## app.overlay
```dts
/{
	fake_can: fake_can {
		compatible = "zephyr,fake-can";
		status = "okay";
	};
};
```

## src/can_fff.c
```c
#include <stdlib.h>
#include <zephyr/drivers/can/can_fake.h>
#include <zephyr/kernel.h>
#include <zephyr/sys/slist.h>
#include <zephyr/ztest.h>

struct can_fff_history_item {
    struct can_frame frame;
    sys_snode_t node;
};
static sys_slist_t can_fff_history;

static void can_fff_frame_history_append(const struct can_frame* frame) {
    struct can_fff_history_item* item = malloc(sizeof(struct can_fff_history_item));
    memcpy(&item->frame, frame, sizeof(struct can_frame));
    sys_slist_append(&can_fff_history, &item->node);
}

static struct can_frame can_fff_frame_history_get_next(void) {
    zassert_false(sys_slist_is_empty(&can_fff_history), "No frames in history.");

    sys_snode_t* item_node = sys_slist_get_not_empty(&can_fff_history);
    struct can_fff_history_item* item = SYS_SLIST_CONTAINER(item_node, item, node);
    struct can_frame frame = item->frame;

    free(item);
    return frame;
}

static volatile int32_t can_fff_send_custom_return_val = 0;
static int32_t can_fff_send_custom(const struct device* dev,
                                   const struct can_frame* frame,
                                   k_timeout_t timeout,
                                   can_tx_callback_t callback,
                                   void* user_data) {
    /* Add the received frame to the history. */
    if (can_fff_send_custom_return_val == 0) {
        can_fff_frame_history_append(frame);
    }

    /* Running the callback will give a semaphore, preventing deadlock. */
    if (callback) { callback(dev, 0, user_data); }

    return can_fff_send_custom_return_val;
}

void can_fff_history_reset(void) {
    while (!sys_slist_is_empty(&can_fff_history)) {
        can_fff_frame_history_get_next();
    }
}

void can_fff_ztest_before(void) {
    /* Ensure the custom fake handler is always set. */
    fake_can_send_fake.custom_fake = can_fff_send_custom;

    /* Fresh history for every new test. */
    can_fff_history_reset();
}

void can_fff_assert_frames_empty(void) {
    zassert_true(sys_slist_is_empty(&can_fff_history), "Frames remaining in history.");
}

void can_fff_assert_popped_frame_equal(struct can_frame frame) {
    struct can_frame hist = can_fff_frame_history_get_next();

    zassert_equal(frame.id,
                  hist.id,
                  "Expected frame id: 0x%08x, history frame id: 0x%08x",
                  frame.id,
                  hist.id);
    zassert_equal(frame.dlc,
                  hist.dlc,
                  "Expected frame dlc: %u, history frame dlc: %u",
                  frame.dlc,
                  hist.dlc);
    uint8_t bytes = can_dlc_to_bytes(frame.dlc);
    for (uint8_t b = 0; b < bytes; b++) {
        zassert_equal(frame.data[b],
                      hist.data[b],
                      "Expected frame data[%u]: 0x%02x, history frame data[%u]: 0x%02x",
                      b,
                      frame.data[b],
                      b,
                      hist.data[b]);
    }
}

void can_fff_set_send_status(int32_t status) {
    can_fff_send_custom_return_val = status;
}
```

## src/can_fff.h
```c
#ifndef CAN_FFF_H
#define CAN_FFF_H

#include <zephyr/drivers/can.h>

/* CAN FFF setup and reset, should be run before any unit tests. */
void can_fff_ztest_before(void);
/* Resets the history of saved CAN frames. */
void can_fff_history_reset(void);
/* Sets the returned status of send calls. */
void can_fff_set_send_status(int32_t status);

/* ZTest assertion helpers. */
void can_fff_assert_frames_empty(void);
void can_fff_assert_popped_frame_equal(struct can_frame frame);

#endif /* CAN_FFF_H */
```

## src/test_publish.c
```c
#include <stdint.h>
#include <stdlib.h>
#include <zephyr/drivers/can/can_fake.h>
#include <zephyr/kernel.h>
#include <zephyr/ztest.h>

#include "can_fff.h"
#include "zcyphal/core.h"

DEFINE_FFF_GLOBALS;

#define NODE_ID (0x55)
#define SUBJECT_ID (0x1234)

#define FILL_VAL(len, val) ((uint8_t)(val))
#define FILL_ARRAY(len, val) LISTIFY(len, FILL_VAL, (, ), val)

const struct device* canbus = DEVICE_DT_GET(DT_NODELABEL(fake_can));
zcy_inst_t inst;

static void publish_suite_before(void* f) {
    zassert_true(device_is_ready(canbus));
    zassert_ok(zcy_init(&inst, canbus, NODE_ID));

    can_fff_ztest_before();
}

ZTEST(publish, test_single_frame) {
    zcy_publisher_t pub;
    zassert_ok(zcy_publisher_init(&pub, &inst, SUBJECT_ID));

    /* Maximum sized single frame. */
    uint8_t pl1[] = {FILL_ARRAY(63, 0x11)};
    zassert_ok(zcy_publish_sync(&pub, ZCY_PRIO_NOMINAL, pl1, 63, K_MSEC(10)));
    can_fff_assert_popped_frame_equal((struct can_frame){
        .id = 0x10723455, .dlc = 15, .data = {FILL_ARRAY(63, 0x11), 0xE0}});
    can_fff_assert_frames_empty();

    /* Single frame with padding. */
    uint8_t pl2[] = {FILL_ARRAY(32, 0x22)};
    zassert_ok(zcy_publish_sync(&pub, ZCY_PRIO_NOMINAL, pl2, 32, K_MSEC(10)));
    can_fff_assert_popped_frame_equal(
        (struct can_frame){.id = 0x10723455,
                           .dlc = 14,
                           .data = {FILL_ARRAY(32, 0x22), FILL_ARRAY(15, 0), 0xE1}});
    can_fff_assert_frames_empty();

    /* Minimum sized single frame (no payload). */
    uint8_t pl3[] = {};
    zassert_ok(zcy_publish_sync(&pub, ZCY_PRIO_NOMINAL, pl3, 0, K_MSEC(10)));
    can_fff_assert_popped_frame_equal((struct can_frame){.id = 0x10723455,
                                                         .dlc = 1,
                                                         .data = {
                                                             0xE2,
                                                         }});
    can_fff_assert_frames_empty();
}

ZTEST(publish, test_frame_priority) {
    zcy_publisher_t pub1, pub2, pub3;
    zassert_ok(zcy_publisher_init(&pub1, &inst, 1));
    zassert_ok(zcy_publisher_init(&pub2, &inst, 2));
    zassert_ok(zcy_publisher_init(&pub3, &inst, 1));

    struct k_sem sem1, sem2, sem3;
    zassert_ok(k_sem_init(&sem1, 0, 1));
    zassert_ok(k_sem_init(&sem2, 0, 1));
    zassert_ok(k_sem_init(&sem3, 0, 1));

    uint8_t pl1[] = {1};
    zassert_ok(zcy_publish(&pub1, ZCY_PRIO_SLOW, pl1, 1, K_MSEC(10), &sem1));
    uint8_t pl2[] = {2};
    zassert_ok(zcy_publish(&pub2, ZCY_PRIO_FAST, pl2, 1, K_MSEC(10), &sem2));
    uint8_t pl3[] = {3};
    zassert_ok(zcy_publish(&pub3, ZCY_PRIO_SLOW, pl3, 1, K_MSEC(10), &sem3));

    k_sem_take(&sem1, K_FOREVER);
    k_sem_take(&sem2, K_FOREVER);
    k_sem_take(&sem3, K_FOREVER);

    can_fff_assert_popped_frame_equal(
        (struct can_frame){.id = 0x8600255, .dlc = 2, .data = {2, 0xE0}});
    can_fff_assert_popped_frame_equal(
        (struct can_frame){.id = 0x18600155, .dlc = 2, .data = {1, 0xE0}});
    can_fff_assert_popped_frame_equal(
        (struct can_frame){.id = 0x18600155, .dlc = 2, .data = {3, 0xE0}});
    can_fff_assert_frames_empty();
}

ZTEST(publish, test_multi_frame) {
    zcy_publisher_t pub;
    zassert_ok(zcy_publisher_init(&pub, &inst, SUBJECT_ID));

    /* Three full frames. */
    uint8_t pl1[] = {FILL_ARRAY(187, 0x33)};
    zassert_ok(zcy_publish_sync(&pub, ZCY_PRIO_NOMINAL, pl1, 187, K_MSEC(10)));
    can_fff_assert_popped_frame_equal((struct can_frame){
        .id = 0x10723455, .dlc = 15, .data = {FILL_ARRAY(63, 0x33), 0xA0}});
    can_fff_assert_popped_frame_equal((struct can_frame){
        .id = 0x10723455, .dlc = 15, .data = {FILL_ARRAY(63, 0x33), 0x00}});
    can_fff_assert_popped_frame_equal((struct can_frame){
        .id = 0x10723455, .dlc = 15, .data = {FILL_ARRAY(61, 0x33), 0x95, 0x90, 0x60}});
    can_fff_assert_frames_empty();

    /* Three frames, CRC by itself on last frame. */
    uint8_t pl2[] = {FILL_ARRAY(126, 0x44)};
    zassert_ok(zcy_publish_sync(&pub, ZCY_PRIO_NOMINAL, pl2, 126, K_MSEC(10)));
    can_fff_assert_popped_frame_equal((struct can_frame){
        .id = 0x10723455, .dlc = 15, .data = {FILL_ARRAY(63, 0x44), 0xA1}});
    can_fff_assert_popped_frame_equal((struct can_frame){
        .id = 0x10723455, .dlc = 15, .data = {FILL_ARRAY(63, 0x44), 0x01}});
    can_fff_assert_popped_frame_equal(
        (struct can_frame){.id = 0x10723455, .dlc = 3, .data = {0x27, 0xF0, 0x61}});
    can_fff_assert_frames_empty();

    /* Three frames, CRC split between frames. */
    uint8_t pl3[] = {FILL_ARRAY(125, 0x55)};
    zassert_ok(zcy_publish_sync(&pub, ZCY_PRIO_NOMINAL, pl3, 125, K_MSEC(10)));
    can_fff_assert_popped_frame_equal((struct can_frame){
        .id = 0x10723455, .dlc = 15, .data = {FILL_ARRAY(63, 0x55), 0xA2}});
    can_fff_assert_popped_frame_equal((struct can_frame){
        .id = 0x10723455, .dlc = 15, .data = {FILL_ARRAY(62, 0x55), 0xEE, 0x02}});
    can_fff_assert_popped_frame_equal(
        (struct can_frame){.id = 0x10723455, .dlc = 2, .data = {0x63, 0x62}});
    can_fff_assert_frames_empty();

    /* Two frames, CRC after padding. */
    uint8_t pl4[] = {FILL_ARRAY(81, 0x66)};
    zassert_ok(zcy_publish_sync(&pub, ZCY_PRIO_NOMINAL, pl4, 81, K_MSEC(10)));
    can_fff_assert_popped_frame_equal((struct can_frame){
        .id = 0x10723455, .dlc = 15, .data = {FILL_ARRAY(63, 0x66), 0xA3}});
    can_fff_assert_popped_frame_equal((struct can_frame){
        .id = 0x10723455,
        .dlc = 12,
        .data = {FILL_ARRAY(18, 0x66), FILL_ARRAY(3, 0), 0xDE, 0x2D, 0x43}});
    can_fff_assert_frames_empty();
}

ZTEST_SUITE(publish, NULL, NULL, publish_suite_before, NULL, NULL);
```

## src/test_transmit.c
```c
#include <stdint.h>
#include <stdlib.h>
#include <zephyr/drivers/can/can_fake.h>
#include <zephyr/kernel.h>
#include <zephyr/ztest.h>

#include "can_fff.h"
#include "zyphal/core.h"

DEFINE_FFF_GLOBALS;

#define NODE_ID (0x55)
#define SUBJECT_ID (0x1234)

#define FILL_VAL(len, val) ((uint8_t)(val))
#define FILL_ARRAY(len, val) LISTIFY(len, FILL_VAL, (, ), val)

const struct device* canbus = DEVICE_DT_GET(DT_NODELABEL(fake_can));
zyphal_inst_t inst;

static void transmit_suite_before(void* f) {
    zassert_true(device_is_ready(canbus));
    zassert_ok(zyphal_init(&inst, canbus, NODE_ID));

    can_fff_ztest_before();
}

ZTEST(transmit, single_frame_message) {
    zyphal_tx_t tx;
    zassert_ok(zyphal_tx_init(&inst, &tx));

    /* Maximum sized single frame. */
    uint8_t pl1[] = {FILL_ARRAY(63, 0x11)};
    zassert_ok(
        zyphal_publish_wait(&tx, ZYPHAL_PRIO_NOMINAL, SUBJECT_ID, pl1, 63, K_MSEC(10)));
    can_fff_assert_popped_frame_equal((struct can_frame){
        .id = 0x10723455, .dlc = 15, .data = {FILL_ARRAY(63, 0x11), 0xE0}});
    can_fff_assert_frames_empty();

    /* Single frame with padding. */
    uint8_t pl2[] = {FILL_ARRAY(32, 0x22)};
    zassert_ok(
        zyphal_publish_wait(&tx, ZYPHAL_PRIO_NOMINAL, SUBJECT_ID, pl2, 32, K_MSEC(10)));
    can_fff_assert_popped_frame_equal(
        (struct can_frame){.id = 0x10723455,
                           .dlc = 14,
                           .data = {FILL_ARRAY(32, 0x22), FILL_ARRAY(15, 0), 0xE1}});
    can_fff_assert_frames_empty();

    /* Minimum sized single frame (no payload). */
    uint8_t pl3[] = {};
    zassert_ok(
        zyphal_publish_wait(&tx, ZYPHAL_PRIO_NOMINAL, SUBJECT_ID, pl3, 0, K_MSEC(10)));
    can_fff_assert_popped_frame_equal((struct can_frame){.id = 0x10723455,
                                                         .dlc = 1,
                                                         .data = {
                                                             0xE2,
                                                         }});
    can_fff_assert_frames_empty();
}

ZTEST(transmit, multi_frame_message) {
    zyphal_tx_t tx;
    zassert_ok(zyphal_tx_init(&inst, &tx));

    /* Three full frames. */
    uint8_t pl1[] = {FILL_ARRAY(187, 0x33)};
    zassert_ok(
        zyphal_publish_wait(&tx, ZYPHAL_PRIO_NOMINAL, SUBJECT_ID, pl1, 187, K_MSEC(10)));
    can_fff_assert_popped_frame_equal((struct can_frame){
        .id = 0x10723455, .dlc = 15, .data = {FILL_ARRAY(63, 0x33), 0xA0}});
    can_fff_assert_popped_frame_equal((struct can_frame){
        .id = 0x10723455, .dlc = 15, .data = {FILL_ARRAY(63, 0x33), 0x00}});
    can_fff_assert_popped_frame_equal((struct can_frame){
        .id = 0x10723455, .dlc = 15, .data = {FILL_ARRAY(61, 0x33), 0x95, 0x90, 0x60}});
    can_fff_assert_frames_empty();

    /* Three frames, CRC by itself on last frame. */
    uint8_t pl2[] = {FILL_ARRAY(126, 0x44)};
    zassert_ok(
        zyphal_publish_wait(&tx, ZYPHAL_PRIO_NOMINAL, SUBJECT_ID, pl2, 126, K_MSEC(10)));
    can_fff_assert_popped_frame_equal((struct can_frame){
        .id = 0x10723455, .dlc = 15, .data = {FILL_ARRAY(63, 0x44), 0xA1}});
    can_fff_assert_popped_frame_equal((struct can_frame){
        .id = 0x10723455, .dlc = 15, .data = {FILL_ARRAY(63, 0x44), 0x01}});
    can_fff_assert_popped_frame_equal(
        (struct can_frame){.id = 0x10723455, .dlc = 3, .data = {0x27, 0xF0, 0x61}});
    can_fff_assert_frames_empty();

    /* Three frames, CRC split between frames. */
    uint8_t pl3[] = {FILL_ARRAY(125, 0x55)};
    zassert_ok(
        zyphal_publish_wait(&tx, ZYPHAL_PRIO_NOMINAL, SUBJECT_ID, pl3, 125, K_MSEC(10)));
    can_fff_assert_popped_frame_equal((struct can_frame){
        .id = 0x10723455, .dlc = 15, .data = {FILL_ARRAY(63, 0x55), 0xA2}});
    can_fff_assert_popped_frame_equal((struct can_frame){
        .id = 0x10723455, .dlc = 15, .data = {FILL_ARRAY(62, 0x55), 0xEE, 0x02}});
    can_fff_assert_popped_frame_equal(
        (struct can_frame){.id = 0x10723455, .dlc = 2, .data = {0x63, 0x62}});
    can_fff_assert_frames_empty();

    /* Two frames, CRC after padding. */
    uint8_t pl4[] = {FILL_ARRAY(81, 0x66)};
    zassert_ok(
        zyphal_publish_wait(&tx, ZYPHAL_PRIO_NOMINAL, SUBJECT_ID, pl4, 81, K_MSEC(10)));
    can_fff_assert_popped_frame_equal((struct can_frame){
        .id = 0x10723455, .dlc = 15, .data = {FILL_ARRAY(63, 0x66), 0xA3}});
    can_fff_assert_popped_frame_equal((struct can_frame){
        .id = 0x10723455,
        .dlc = 12,
        .data = {FILL_ARRAY(18, 0x66), FILL_ARRAY(3, 0), 0xDE, 0x2D, 0x43}});
    can_fff_assert_frames_empty();
}

static void publish_done_cb(void* user_data, int32_t status) {
    struct k_sem* sem = (struct k_sem*)user_data;
    k_sem_give(sem);
}

ZTEST(transmit, priority_ordering) {
    zyphal_tx_t txs[9];
    for (size_t i = 0; i < ARRAY_SIZE(txs); i++) {
        zassert_ok(zyphal_tx_init(&inst, &txs[i]));
    }

    struct k_sem sem;
    zassert_ok(k_sem_init(&sem, 0, 9));

    /* Publish all possible priorities in reverse order. */
    uint8_t payloads[] = {0, 1, 2, 3, 4, 5, 6, 7, 8};
    uint8_t priorities[] = {ZYPHAL_PRIO_OPTIONAL,
                            ZYPHAL_PRIO_SLOW,
                            ZYPHAL_PRIO_LOW,
                            ZYPHAL_PRIO_NOMINAL,
                            ZYPHAL_PRIO_HIGH,
                            ZYPHAL_PRIO_FAST,
                            ZYPHAL_PRIO_IMMEDIATE,
                            ZYPHAL_PRIO_EXCEPTIONAL,
                            ZYPHAL_PRIO_NOMINAL};
    for (size_t i = 0; i < ARRAY_SIZE(txs); i++) {
        zassert_ok(zyphal_publish(&txs[i],
                                  priorities[i],
                                  SUBJECT_ID,
                                  &payloads[i],
                                  1,
                                  K_MSEC(10),
                                  publish_done_cb,
                                  &sem));
    }

    for (size_t i = 0; i < sem.limit; i++) { zassert_ok(k_sem_take(&sem, K_FOREVER)); }

    struct can_frame expected_frames[] = {
        {.id = 0x723455, .dlc = 2, .data = {7, 0xE0}},
        {.id = 0x4723455, .dlc = 2, .data = {6, 0xE0}},
        {.id = 0x8723455, .dlc = 2, .data = {5, 0xE0}},
        {.id = 0xC723455, .dlc = 2, .data = {4, 0xE0}},
        {.id = 0x10723455, .dlc = 2, .data = {3, 0xE0}},
        {.id = 0x10723455, .dlc = 2, .data = {8, 0xE0}},
        {.id = 0x14723455, .dlc = 2, .data = {2, 0xE0}},
        {.id = 0x18723455, .dlc = 2, .data = {1, 0xE0}},
        {.id = 0x1C723455, .dlc = 2, .data = {0, 0xE0}}};
    for (size_t i = 0; i < ARRAY_SIZE(expected_frames); i++) {
        can_fff_assert_popped_frame_equal(expected_frames[i]);
    }
}

ZTEST(transmit, transfer_id) {
    zyphal_tx_t tx;
    zassert_ok(zyphal_tx_init(&inst, &tx));

    uint8_t payload[] = {1};
    for (uint8_t i = 0; i < 32; i++) {
        zassert_ok(zyphal_publish_wait(
            &tx, ZYPHAL_PRIO_NOMINAL, SUBJECT_ID, payload, 1, K_MSEC(10)));
    }

    for (uint8_t i = 0; i < 32; i++) {
        uint8_t transfer_id = i;
        can_fff_assert_popped_frame_equal((struct can_frame){
            .id = 0x10723455, .dlc = 2, .data = {0x01, 0xE0 | transfer_id}});
    }
    can_fff_assert_frames_empty();

    /* Next transfer ID should wrap around to 0. */
    zassert_ok(zyphal_publish_wait(
        &tx, ZYPHAL_PRIO_NOMINAL, SUBJECT_ID, payload, 1, K_MSEC(10)));
    can_fff_assert_popped_frame_equal(
        (struct can_frame){.id = 0x10723455, .dlc = 2, .data = {0x01, 0xE0}});
    can_fff_assert_frames_empty();
}

ZTEST(transmit, busy_transfer) {
    zyphal_tx_t tx;
    zassert_ok(zyphal_tx_init(&inst, &tx));

    struct k_sem sem;
    zassert_ok(k_sem_init(&sem, 0, 1));

    uint8_t pl[] = {1};
    zassert_ok(zyphal_publish(
        &tx, ZYPHAL_PRIO_LOW, SUBJECT_ID, pl, 1, K_MSEC(10), publish_done_cb, &sem));
    /* Transfer should fail with -EALREADY when first is still pending. */
    zassert_equal(
        zyphal_publish(
            &tx, ZYPHAL_PRIO_LOW, SUBJECT_ID, pl, 1, K_MSEC(10), publish_done_cb, &sem),
        -EALREADY);
    zassert_true(zyphal_tx_pending(&tx));

    /* Once first transfer completes, second transfer should succeed. */
    k_sem_take(&sem, K_FOREVER);
    zassert_ok(zyphal_publish(
        &tx, ZYPHAL_PRIO_LOW, SUBJECT_ID, pl, 1, K_MSEC(10), publish_done_cb, &sem));
    k_sem_take(&sem, K_FOREVER);
    zassert_false(zyphal_tx_pending(&tx));

    /* Verify both frames were sent. */
    can_fff_assert_popped_frame_equal(
        (struct can_frame){.id = 0x14723455, .dlc = 2, .data = {1, 0xE0}});
    can_fff_assert_popped_frame_equal(
        (struct can_frame){.id = 0x14723455, .dlc = 2, .data = {1, 0xE1}});
    can_fff_assert_frames_empty();
}

static void publish_done_canceled_cb(void* user_data, int32_t status) {
    zassert_equal(status, -ECANCELED);
    struct k_sem* sem = (struct k_sem*)user_data;
    k_sem_give(sem);
}

ZTEST(transmit, cancel_transfer) {
    zyphal_tx_t tx;
    zassert_ok(zyphal_tx_init(&inst, &tx));

    struct k_sem sem;
    zassert_ok(k_sem_init(&sem, 0, 1));

    uint8_t pl[] = {1};
    zassert_ok(zyphal_publish(&tx,
                              ZYPHAL_PRIO_LOW,
                              SUBJECT_ID,
                              pl,
                              1,
                              K_MSEC(10),
                              publish_done_canceled_cb,
                              &sem));
    zassert_true(zyphal_tx_pending(&tx));

    /* Cancel transfer. */
    zassert_ok(zyphal_tx_cancel(&tx));
    zassert_false(zyphal_tx_pending(&tx));
    /* Callback should still be called for the canceled transfer. */
    k_sem_take(&sem, K_FOREVER);
    /* But canceled transfer should not send can frames. */
    can_fff_assert_frames_empty();
}

ZTEST(transmit, errors) {
    zyphal_tx_t tx;
    zassert_ok(zyphal_tx_init(&inst, &tx));

    uint8_t payload[] = {1};
    /* NULL parameters. */
    zassert_equal(
        zyphal_publish_wait(NULL, ZYPHAL_PRIO_LOW, SUBJECT_ID, payload, 1, K_MSEC(10)),
        -EINVAL);
    zassert_equal(
        zyphal_publish_wait(&tx, ZYPHAL_PRIO_LOW, SUBJECT_ID, NULL, 1, K_MSEC(10)),
        -EINVAL);
    /* Parameters out of range. */
    zassert_equal(zyphal_publish_wait(
                      &tx, ZYPHAL_PRIO_OPTIONAL + 1, SUBJECT_ID, payload, 1, K_MSEC(10)),
                  -EINVAL);
    zassert_equal(
        zyphal_publish_wait(
            &tx, ZYPHAL_PRIO_LOW, ZYPHAL_MAX_SUBJECT_ID + 1, payload, 1, K_MSEC(10)),
        -EINVAL);
    /* CAN send errors. */
    can_fff_set_send_status(-ENETDOWN);
    zassert_equal(
        zyphal_publish_wait(&tx, ZYPHAL_PRIO_LOW, SUBJECT_ID, payload, 1, K_MSEC(10)),
        -ENETDOWN);
    can_fff_set_send_status(0);

    can_fff_assert_frames_empty();
}

ZTEST_SUITE(transmit, NULL, NULL, transmit_suite_before, NULL, NULL);
```
